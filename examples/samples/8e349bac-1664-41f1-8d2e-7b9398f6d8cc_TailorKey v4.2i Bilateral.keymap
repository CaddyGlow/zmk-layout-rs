/*
 * Copyright (c) 2020 The ZMK Contributors
 * Copyright (c) 2025 Innaworks Development Limited, trading as MoErgo
 *
 * SPDX-License-Identifier: MIT
 */


/* THIS FILE WAS GENERATED BY GLOVE80 LAYOUT EDITOR
 *
 * This file was generated automatically. You may or may not want to
 * edit it directly.
 */

#include <behaviors.dtsi>
/* Include all behavior includes needed */
#include <dt-bindings/zmk/outputs.h>
#include <dt-bindings/zmk/keys.h>
#include <dt-bindings/zmk/bt.h>
#include <dt-bindings/zmk/rgb.h>

/* On demand includes */
#include <dt-bindings/zmk/input_transform.h>
#include <dt-bindings/zmk/pointing.h>
#include <input/processors.dtsi>

/* Helper Macros, based on https://github.com/urob/zmk-helpers/ */

#pragma once

#define ZMK_HELPER_STRINGIFY(x) #x

// Preprocessor mechanism to overload macros, cf. https://stackoverflow.com/a/27051616/6114651
#define VARGS_(_10, _9, _8, _7, _6, _5, _4, _3, _2, _1, N, ...) N
#define VARGS(...) VARGS_(__VA_ARGS__, 10, 9, 8, 7, 6, 5, 4, 3, 2, 1, 0)
#define CONCAT_(a, b) a##b
#define CONCAT(a, b) CONCAT_(a, b)

#define ZMK_BEHAVIOR_CORE_tap_dance  \
    compatible = "zmk,behavior-tap-dance"; \
    #binding-cells = <0>

#define ZMK_BEHAVIOR(name, type, ...) \
    name: name { \
        ZMK_BEHAVIOR_CORE_ ## type; \
        __VA_ARGS__ \
    };

#define ZMK_TAP_DANCE(name, ...) \
    ZMK_BEHAVIOR(name, tap_dance, __VA_ARGS__)

#define ZMK_TD_LAYER(name, layer) \
    ZMK_TAP_DANCE(name, \
        tapping-term-ms = <200>; \
        bindings = <&mo layer>, <&to layer>; \
)

/* Automatically generated layer name #define */
#define LAYER_HRM_WinLinx 0
#define LAYER_Typing 1
#define LAYER_Autoshift 2
#define LAYER_Cursor 3
#define LAYER_Symbol 4
#define LAYER_Gaming 5
#define LAYER_Lower 6
#define LAYER_LeftIndex 7
#define LAYER_LeftMiddy 8
#define LAYER_LeftRingy 9
#define LAYER_LeftPinky 10
#define LAYER_RightIndex 11
#define LAYER_RightMiddy 12
#define LAYER_RightRingy 13
#define LAYER_RightPinky 14
#define LAYER_Mouse 15
#define LAYER_MouseSlow 16
#define LAYER_MouseFast 17
#define LAYER_MouseWarp 18
#define LAYER_Magic 19

/* To deal with the situation where there is no Lower layer, to keep &lower happy */
#ifndef LAYER_Lower
#define LAYER_Lower 0
#endif

/* Custom Device-tree */


/* Input Listeners */
&mmv_input_listener {
    // LAYER_MouseSlow
    LAYER_MouseSlow {
        layers = <16>;
        input-processors = <&zip_xy_scaler 1 9>;
    };
    // LAYER_MouseFast
    LAYER_MouseFast {
        layers = <17>;
        input-processors = <&zip_xy_scaler 3 1>;
    };
    // LAYER_MouseWarp
    LAYER_MouseWarp {
        layers = <18>;
        input-processors = <&zip_xy_scaler 12 1>;
    };
};

&msc_input_listener {
    // LAYER_MouseSlow
    LAYER_MouseSlow {
        layers = <16>;
        input-processors = <&zip_scroll_scaler 1 9>;
    };
    // LAYER_MouseFast
    LAYER_MouseFast {
        layers = <17>;
        input-processors = <&zip_scroll_scaler 3 1>;
    };
    // LAYER_MouseWarp
    LAYER_MouseWarp {
        layers = <18>;
        input-processors = <&zip_scroll_scaler 12 1>;
    };
};

/* System behavior and Macros */
/ {
    behaviors {
        ZMK_TD_LAYER(lower, LAYER_Lower)
    };
};

/ {
    macros {
        rgb_ug_status_macro: rgb_ug_status_macro {
            label = "RGB_UG_STATUS";
            compatible = "zmk,behavior-macro";
            #binding-cells = <0>;
            bindings
                = <&rgb_ug RGB_STATUS>;
        };
    };
};


/ {
#ifdef BT_DISC_CMD
    behaviors {
        bt_0: bt_0 {
            compatible = "zmk,behavior-tap-dance";
            label = "BT_0";
            #binding-cells = <0>;
            tapping-term-ms = <200>;
            bindings = <&bt_select_0>, <&bt BT_DISC 0>;
        };
        bt_1: bt_1 {
            compatible = "zmk,behavior-tap-dance";
            label = "BT_1";
            #binding-cells = <0>;
            tapping-term-ms = <200>;
            bindings = <&bt_select_1>, <&bt BT_DISC 1>;
        };
        bt_2: bt_2 {
            compatible = "zmk,behavior-tap-dance";
            label = "BT_2";
            #binding-cells = <0>;
            tapping-term-ms = <200>;
            bindings = <&bt_select_2>, <&bt BT_DISC 2>;
        };
        bt_3: bt_3 {
            compatible = "zmk,behavior-tap-dance";
            label = "BT_3";
            #binding-cells = <0>;
            tapping-term-ms = <200>;
            bindings = <&bt_select_3>, <&bt BT_DISC 3>;
        };
    };
    macros {
        bt_select_0: bt_select_0 {
            label = "BT_SELECT_0";
            compatible = "zmk,behavior-macro";
            #binding-cells = <0>;
            bindings
                = <&out OUT_BLE>,
                  <&bt BT_SEL 0>;
        };
        bt_select_1: bt_select_1 {
            label = "BT_SELECT_1";
            compatible = "zmk,behavior-macro";
            #binding-cells = <0>;
            bindings
                = <&out OUT_BLE>,
                  <&bt BT_SEL 1>;
        };
        bt_select_2: bt_select_2 {
            label = "BT_SELECT_2";
            compatible = "zmk,behavior-macro";
            #binding-cells = <0>;
            bindings
                = <&out OUT_BLE>,
                  <&bt BT_SEL 2>;
        };
        bt_select_3: bt_select_3 {
            label = "BT_SELECT_3";
            compatible = "zmk,behavior-macro";
            #binding-cells = <0>;
            bindings
                = <&out OUT_BLE>,
                  <&bt BT_SEL 3>;
        };
    };
#else
    macros {
        bt_0: bt_0 {
            label = "BT_0";
            compatible = "zmk,behavior-macro";
            #binding-cells = <0>;
            bindings
                = <&out OUT_BLE>,
                  <&bt BT_SEL 0>;
        };
        bt_1: bt_1 {
            label = "BT_1";
            compatible = "zmk,behavior-macro";
            #binding-cells = <0>;
            bindings
                = <&out OUT_BLE>,
                  <&bt BT_SEL 1>;
        };
        bt_2: bt_2 {
            label = "BT_2";
            compatible = "zmk,behavior-macro";
            #binding-cells = <0>;
            bindings
                = <&out OUT_BLE>,
                  <&bt BT_SEL 2>;
        };
        bt_3: bt_3 {
            label = "BT_3";
            compatible = "zmk,behavior-macro";
            #binding-cells = <0>;
            bindings
                = <&out OUT_BLE>,
                  <&bt BT_SEL 3>;
        };
    };
#endif
};

/ {
    behaviors {
        magic: magic {
            compatible = "zmk,behavior-hold-tap";
            label = "MAGIC_HOLD_TAP";
            #binding-cells = <2>;
            flavor = "tap-preferred";
            tapping-term-ms = <200>;
            bindings = <&mo>, <&rgb_ug_status_macro>;
        };
    };
};

/* #define for key positions */
#define POS_LH_T1 52
#define POS_LH_T2 53
#define POS_LH_T3 54
#define POS_LH_T4 69
#define POS_LH_T5 70
#define POS_LH_T6 71
#define POS_LH_C1R2 15
#define POS_LH_C1R3 27
#define POS_LH_C1R4 39
#define POS_LH_C1R5 51
#define POS_LH_C2R1 4
#define POS_LH_C2R2 14
#define POS_LH_C2R3 26
#define POS_LH_C2R4 38
#define POS_LH_C2R5 50
#define POS_LH_C2R6 68
#define POS_LH_C3R1 3
#define POS_LH_C3R2 13
#define POS_LH_C3R3 25
#define POS_LH_C3R4 37
#define POS_LH_C3R5 49
#define POS_LH_C3R6 67
#define POS_LH_C4R1 2
#define POS_LH_C4R2 12
#define POS_LH_C4R3 24
#define POS_LH_C4R4 36
#define POS_LH_C4R5 48
#define POS_LH_C4R6 66
#define POS_LH_C5R1 1
#define POS_LH_C5R2 11
#define POS_LH_C5R3 23
#define POS_LH_C5R4 35
#define POS_LH_C5R5 47
#define POS_LH_C5R6 65
#define POS_LH_C6R1 0
#define POS_LH_C6R2 10
#define POS_LH_C6R3 22
#define POS_LH_C6R4 34
#define POS_LH_C6R5 46
#define POS_LH_C6R6 64
#define POS_RH_T1 57
#define POS_RH_T2 56
#define POS_RH_T3 55
#define POS_RH_T4 74
#define POS_RH_T5 73
#define POS_RH_T6 72
#define POS_RH_C1R2 16
#define POS_RH_C1R3 28
#define POS_RH_C1R4 40
#define POS_RH_C1R5 58
#define POS_RH_C2R1 5
#define POS_RH_C2R2 17
#define POS_RH_C2R3 29
#define POS_RH_C2R4 41
#define POS_RH_C2R5 59
#define POS_RH_C2R6 75
#define POS_RH_C3R1 6
#define POS_RH_C3R2 18
#define POS_RH_C3R3 30
#define POS_RH_C3R4 42
#define POS_RH_C3R5 60
#define POS_RH_C3R6 76
#define POS_RH_C4R1 7
#define POS_RH_C4R2 19
#define POS_RH_C4R3 31
#define POS_RH_C4R4 43
#define POS_RH_C4R5 61
#define POS_RH_C4R6 77
#define POS_RH_C5R1 8
#define POS_RH_C5R2 20
#define POS_RH_C5R3 32
#define POS_RH_C5R4 44
#define POS_RH_C5R5 62
#define POS_RH_C5R6 78
#define POS_RH_C6R1 9
#define POS_RH_C6R2 21
#define POS_RH_C6R3 33
#define POS_RH_C6R4 45
#define POS_RH_C6R5 63
#define POS_RH_C6R6 79

/* Custom Defined Behaviors */
/ {

};

/* Generated input processors */


/* Automatically generated macro definitions */
/ {
    macros {

        // AutoShift Helper- &AS main macro is chained to &AS_HT hold tap and &AS_Shifted macro - TailorKey
        AS_Shifted_v1_TKZ: AS_Shifted_v1_TKZ {
            label = "&AS_SHIFTED_V1_TKZ";
            compatible = "zmk,behavior-macro-one-param";
            #binding-cells = <1>;
            bindings = <&macro_press>
                , <&kp LSHFT>
                , <&macro_tap>
                , <&macro_param_1to1>
                , <&kp N1>
                , <&macro_release>
                , <&kp LSHFT>;
        };

        // AutoShift (Assign &AS to a Key) - &AS main macro is chained to &AS_HT hold tap and &AS_Shifted macro - TailorKey
        AS_v1_TKZ: AS_v1_TKZ {
            label = "&AS_V1_TKZ";
            compatible = "zmk,behavior-macro-one-param";
            #binding-cells = <1>;
            tap-ms = <10>;
            wait-ms = <10>;
            bindings = <&macro_press>
                , <&macro_param_1to1>
                , <&macro_param_1to2>
                , <&AS_HT_v2_TKZ A A>
                , <&macro_pause_for_release>
                , <&macro_release>
                , <&macro_param_1to1>
                , <&macro_param_1to2>
                , <&AS_HT_v2_TKZ A A>;
        };

        // Cursor Layer - Extent Line (seq) - TailorKey
        cur_EXTEND_LINE_v1_TKZ: cur_EXTEND_LINE_v1_TKZ {
            label = "&CUR_EXTEND_LINE_V1_TKZ";
            compatible = "zmk,behavior-macro";
            #binding-cells = <0>;
            tap-ms = <1>;
            wait-ms = <1>;
            bindings = <&kp LS(END)>;
        };

        // Cursor Layer - Extend Word (seq) - TailorKey
        cur_EXTEND_WORD_v1_TKZ: cur_EXTEND_WORD_v1_TKZ {
            label = "&CUR_EXTEND_WORD_V1_TKZ";
            compatible = "zmk,behavior-macro";
            #binding-cells = <0>;
            tap-ms = <1>;
            wait-ms = <1>;
            bindings = <&kp LC(LS(RIGHT))>;
        };

        // Cursor Layer - Select Line (seq) - TailorKey
        cur_SELECT_LINE_v1_TKZ: cur_SELECT_LINE_v1_TKZ {
            label = "&CUR_SELECT_LINE_V1_TKZ";
            compatible = "zmk,behavior-macro";
            #binding-cells = <0>;
            tap-ms = <1>;
            wait-ms = <1>;
            bindings = <&kp HOME>
                , <&kp LS(END)>;
        };

        // Cursor Layer - Select None (seq) - TailorKey
        cur_SELECT_NONE_v1_TKZ: cur_SELECT_NONE_v1_TKZ {
            label = "&CUR_SELECT_NONE_V1_TKZ";
            compatible = "zmk,behavior-macro";
            #binding-cells = <0>;
            tap-ms = <1>;
            wait-ms = <1>;
            bindings = <&kp DOWN>
                , <&kp UP>
                , <&kp RIGHT>
                , <&kp LEFT>;
        };

        // Cursor Layer - Select Word (seq) - TailorKey
        cur_SELECT_WORD_v1_TKZ: cur_SELECT_WORD_v1_TKZ {
            label = "&CUR_SELECT_WORD_V1_TKZ";
            compatible = "zmk,behavior-macro";
            #binding-cells = <0>;
            tap-ms = <1>;
            wait-ms = <1>;
            bindings = <&kp LC(LEFT)>
                , <&kp LC(LS(RIGHT))>;
        };

        // HRM_left_index_hold -> swich layer  - TailorKey
        HRM_left_index_hold_v1B_TKZ: HRM_left_index_hold_v1B_TKZ {
            label = "&HRM_LEFT_INDEX_HOLD_V1B_TKZ";
            compatible = "zmk,behavior-macro-one-param";
            #binding-cells = <1>;
            tap-ms = <0>;
            wait-ms = <0>;
            bindings = <&macro_press>
                , <&macro_param_1to1>
                , <&kp A>
                , <&mo 7>
                , <&macro_pause_for_release>
                , <&macro_release>
                , <&macro_param_1to1>
                , <&kp A>
                , <&mo 7>;
        };

        // HRM_left_index_tap - incl. QWERTY alpha character - TailorKey
        HRM_left_index_tap_v1B_TKZ: HRM_left_index_tap_v1B_TKZ {
            label = "&HRM_LEFT_INDEX_TAP_V1B_TKZ";
            compatible = "zmk,behavior-macro-one-param";
            #binding-cells = <1>;
            tap-ms = <0>;
            wait-ms = <0>;
            bindings = <&macro_release>
                , <&kp LSHFT>
                , <&kp RSHFT>
                , <&kp LALT>
                , <&kp RALT>
                , <&kp LCTRL>
                , <&kp RCTRL>
                , <&kp LGUI>
                , <&kp RGUI>
                , <&macro_tap>
                , <&kp F>
                , <&macro_tap>
                , <&macro_param_1to1>
                , <&kp A>;
        };

        // HRM_left_middy_hold -> swich layer - TailorKey
        HRM_left_middy_hold_v1B_TKZ: HRM_left_middy_hold_v1B_TKZ {
            label = "&HRM_LEFT_MIDDY_HOLD_V1B_TKZ";
            compatible = "zmk,behavior-macro-one-param";
            #binding-cells = <1>;
            tap-ms = <0>;
            wait-ms = <0>;
            bindings = <&macro_press>
                , <&macro_param_1to1>
                , <&kp A>
                , <&mo 8>
                , <&macro_pause_for_release>
                , <&macro_release>
                , <&macro_param_1to1>
                , <&kp A>
                , <&mo 8>;
        };

        // HRM_left_middy_tap - incl. QWERTY alpha character - TailorKey
        HRM_left_middy_tap_v1B_TKZ: HRM_left_middy_tap_v1B_TKZ {
            label = "&HRM_LEFT_MIDDY_TAP_V1B_TKZ";
            compatible = "zmk,behavior-macro-one-param";
            #binding-cells = <1>;
            tap-ms = <0>;
            wait-ms = <0>;
            bindings = <&macro_release>
                , <&kp LSHFT>
                , <&kp RSHFT>
                , <&kp LALT>
                , <&kp RALT>
                , <&kp LCTRL>
                , <&kp RCTRL>
                , <&kp LGUI>
                , <&kp RGUI>
                , <&macro_tap>
                , <&kp D>
                , <&macro_tap>
                , <&macro_param_1to1>
                , <&kp A>;
        };

        // HRM_left_pinky_hold -> swich layer - TailorKey
        HRM_left_pinky_hold_v1B_TKZ: HRM_left_pinky_hold_v1B_TKZ {
            label = "&HRM_LEFT_PINKY_HOLD_V1B_TKZ";
            compatible = "zmk,behavior-macro-one-param";
            #binding-cells = <1>;
            tap-ms = <0>;
            wait-ms = <0>;
            bindings = <&macro_press>
                , <&macro_param_1to1>
                , <&kp A>
                , <&mo 10>
                , <&macro_pause_for_release>
                , <&macro_release>
                , <&macro_param_1to1>
                , <&kp A>
                , <&mo 10>;
        };

        // HRM_left_pinky_tap - incl. QWERTY alpha character - TailorKey
        HRM_left_pinky_tap_v1B_TKZ: HRM_left_pinky_tap_v1B_TKZ {
            label = "&HRM_LEFT_PINKY_TAP_V1B_TKZ";
            compatible = "zmk,behavior-macro-one-param";
            #binding-cells = <1>;
            tap-ms = <0>;
            wait-ms = <0>;
            bindings = <&macro_release>
                , <&kp LSHFT>
                , <&kp RSHFT>
                , <&kp LALT>
                , <&kp RALT>
                , <&kp LCTRL>
                , <&kp RCTRL>
                , <&kp LGUI>
                , <&kp RGUI>
                , <&macro_tap>
                , <&kp A>
                , <&macro_tap>
                , <&macro_param_1to1>
                , <&kp A>;
        };

        // HRM_left_ring_hold -> swich layer - TailorKey
        HRM_left_ring_hold_v1B_TKZ: HRM_left_ring_hold_v1B_TKZ {
            label = "&HRM_LEFT_RING_HOLD_V1B_TKZ";
            compatible = "zmk,behavior-macro-one-param";
            #binding-cells = <1>;
            tap-ms = <0>;
            wait-ms = <0>;
            bindings = <&macro_press>
                , <&macro_param_1to1>
                , <&kp A>
                , <&mo 9>
                , <&macro_pause_for_release>
                , <&macro_release>
                , <&macro_param_1to1>
                , <&kp A>
                , <&mo 9>;
        };

        // HRM_left_ring_tap - incl. QWERTY alpha character - TailorKey
        HRM_left_ring_tap_v1B_TKZ: HRM_left_ring_tap_v1B_TKZ {
            label = "&HRM_LEFT_RING_TAP_V1B_TKZ";
            compatible = "zmk,behavior-macro-one-param";
            #binding-cells = <1>;
            tap-ms = <0>;
            wait-ms = <0>;
            bindings = <&macro_release>
                , <&kp LSHFT>
                , <&kp RSHFT>
                , <&kp LALT>
                , <&kp RALT>
                , <&kp LCTRL>
                , <&kp RCTRL>
                , <&kp LGUI>
                , <&kp RGUI>
                , <&macro_tap>
                , <&kp S>
                , <&macro_tap>
                , <&macro_param_1to1>
                , <&kp A>;
        };

        // HRM_right_index_hold -> swich layer - TailorKey
        HRM_right_index_hold_v1B_TKZ: HRM_right_index_hold_v1B_TKZ {
            label = "&HRM_RIGHT_INDEX_HOLD_V1B_TKZ";
            compatible = "zmk,behavior-macro-one-param";
            #binding-cells = <1>;
            tap-ms = <0>;
            wait-ms = <0>;
            bindings = <&macro_press>
                , <&macro_param_1to1>
                , <&kp A>
                , <&mo 11>
                , <&macro_pause_for_release>
                , <&macro_release>
                , <&macro_param_1to1>
                , <&kp A>
                , <&mo 11>;
        };

        // HRM_right_index_tap - incl. QWERTY alpha character - TailorKey
        HRM_right_index_tap_v1B_TKZ: HRM_right_index_tap_v1B_TKZ {
            label = "&HRM_RIGHT_INDEX_TAP_V1B_TKZ";
            compatible = "zmk,behavior-macro-one-param";
            #binding-cells = <1>;
            tap-ms = <0>;
            wait-ms = <0>;
            bindings = <&macro_release>
                , <&kp LSHFT>
                , <&kp RSHFT>
                , <&kp LALT>
                , <&kp RALT>
                , <&kp LCTRL>
                , <&kp RCTRL>
                , <&kp LGUI>
                , <&kp RGUI>
                , <&macro_tap>
                , <&kp J>
                , <&macro_tap>
                , <&macro_param_1to1>
                , <&kp A>;
        };

        // HRM_right_middy_hold -> swich layer - TailorKey
        HRM_right_middy_hold_v1B_TKZ: HRM_right_middy_hold_v1B_TKZ {
            label = "&HRM_RIGHT_MIDDY_HOLD_V1B_TKZ";
            compatible = "zmk,behavior-macro-one-param";
            #binding-cells = <1>;
            tap-ms = <0>;
            wait-ms = <0>;
            bindings = <&macro_press>
                , <&macro_param_1to1>
                , <&kp A>
                , <&mo 12>
                , <&macro_pause_for_release>
                , <&macro_release>
                , <&macro_param_1to1>
                , <&kp A>
                , <&mo 12>;
        };

        // HRM_right_middy_tap - incl. QWERTY alpha character - TailorKey
        HRM_right_middy_tap_v1B_TKZ: HRM_right_middy_tap_v1B_TKZ {
            label = "&HRM_RIGHT_MIDDY_TAP_V1B_TKZ";
            compatible = "zmk,behavior-macro-one-param";
            #binding-cells = <1>;
            tap-ms = <0>;
            wait-ms = <0>;
            bindings = <&macro_release>
                , <&kp LSHFT>
                , <&kp RSHFT>
                , <&kp LALT>
                , <&kp RALT>
                , <&kp LCTRL>
                , <&kp RCTRL>
                , <&kp LGUI>
                , <&kp RGUI>
                , <&macro_tap>
                , <&kp K>
                , <&macro_tap>
                , <&macro_param_1to1>
                , <&kp A>;
        };

        // HRM_right_pinky_hold -> swich layer - TailorKey
        HRM_right_pinky_hold_v1B_TKZ: HRM_right_pinky_hold_v1B_TKZ {
            label = "&HRM_RIGHT_PINKY_HOLD_V1B_TKZ";
            compatible = "zmk,behavior-macro-one-param";
            #binding-cells = <1>;
            tap-ms = <0>;
            wait-ms = <0>;
            bindings = <&macro_press>
                , <&macro_param_1to1>
                , <&kp A>
                , <&mo 14>
                , <&macro_pause_for_release>
                , <&macro_release>
                , <&macro_param_1to1>
                , <&kp A>
                , <&mo 14>;
        };

        // HRM_right_pinky_tap - incl. QWERTY alpha character - TailorKey
        HRM_right_pinky_tap_v1B_TKZ: HRM_right_pinky_tap_v1B_TKZ {
            label = "&HRM_RIGHT_PINKY_TAP_V1B_TKZ";
            compatible = "zmk,behavior-macro-one-param";
            #binding-cells = <1>;
            tap-ms = <0>;
            wait-ms = <0>;
            bindings = <&macro_release>
                , <&kp LSHFT>
                , <&kp RSHFT>
                , <&kp LALT>
                , <&kp RALT>
                , <&kp LCTRL>
                , <&kp RCTRL>
                , <&kp LGUI>
                , <&kp RGUI>
                , <&macro_tap>
                , <&kp SEMI>
                , <&macro_tap>
                , <&macro_param_1to1>
                , <&kp A>;
        };

        // HRM_right_ring_hold -> swich layer - TailorKey
        HRM_right_ring_hold_v1B_TKZ: HRM_right_ring_hold_v1B_TKZ {
            label = "&HRM_RIGHT_RING_HOLD_V1B_TKZ";
            compatible = "zmk,behavior-macro-one-param";
            #binding-cells = <1>;
            tap-ms = <0>;
            wait-ms = <0>;
            bindings = <&macro_press>
                , <&macro_param_1to1>
                , <&kp A>
                , <&mo 13>
                , <&macro_pause_for_release>
                , <&macro_release>
                , <&macro_param_1to1>
                , <&kp A>
                , <&mo 13>;
        };

        // HRM_right_ring_tap - incl. QWERTY alpha character - TailorKey
        HRM_right_ring_tap_v1B_TKZ: HRM_right_ring_tap_v1B_TKZ {
            label = "&HRM_RIGHT_RING_TAP_V1B_TKZ";
            compatible = "zmk,behavior-macro-one-param";
            #binding-cells = <1>;
            tap-ms = <0>;
            wait-ms = <0>;
            bindings = <&macro_release>
                , <&kp LSHFT>
                , <&kp RSHFT>
                , <&kp LALT>
                , <&kp RALT>
                , <&kp LCTRL>
                , <&kp RCTRL>
                , <&kp LGUI>
                , <&kp RGUI>
                , <&macro_tap>
                , <&kp L>
                , <&macro_tap>
                , <&macro_param_1to1>
                , <&kp A>;
        };

        // mod_tab_switcher_chord -  TailorKey
        mod_tab_chord_v2_TKZ: mod_tab_chord_v2_TKZ {
            label = "&MOD_TAB_CHORD_V2_TKZ";
            compatible = "zmk,behavior-macro-two-param";
            #binding-cells = <2>;
            tap-ms = <0>;
            wait-ms = <0>;
            bindings = <&macro_press>
                , <&macro_param_2to1>
                , <&mo MACRO_PLACEHOLDER>
                , <&macro_press>
                , <&macro_param_1to1>
                , <&mod_tab_v1_TKZ MACRO_PLACEHOLDER>
                , <&macro_pause_for_release>
                , <&macro_release>
                , <&macro_param_1to1>
                , <&mod_tab_v1_TKZ MACRO_PLACEHOLDER>
                , <&macro_release>
                , <&macro_param_2to1>
                , <&mo MACRO_PLACEHOLDER>;
        };

        // mod_tab_switcher - TailorKey
        //
        //
        mod_tab_v1_TKZ: mod_tab_v1_TKZ {
            label = "&MOD_TAB_V1_TKZ";
            compatible = "zmk,behavior-macro-one-param";
            #binding-cells = <1>;
            tap-ms = <0>;
            wait-ms = <0>;
            bindings = <&macro_press>
                , <&macro_param_1to1>
                , <&kp MACRO_PLACEHOLDER>
                , <&macro_tap>
                , <&kp TAB>
                , <&macro_pause_for_release>
                , <&macro_release>
                , <&macro_param_1to1>
                , <&kp MACRO_PLACEHOLDER>;
        };

        // mod_tab_switcher - TailorKey
        //
        //
        mod_tab_v2_TKZ: mod_tab_v2_TKZ {
            label = "&MOD_TAB_V2_TKZ";
            compatible = "zmk,behavior-macro-one-param";
            #binding-cells = <1>;
            tap-ms = <0>;
            wait-ms = <0>;
            bindings = <&macro_press>
                , <&macro_param_1to1>
                , <&kp MACRO_PLACEHOLDER>
                , <&macro_tap>
                , <&kp TAB>
                , <&macro_pause_for_release>
                , <&macro_release>
                , <&macro_param_1to1>
                , <&kp MACRO_PLACEHOLDER>;
        };

        // macro string1 sample - Magic Layer F1 - Text output sample macro 1 "¡Hola!" - TailorKey
        mstr1_v1_TKZ: mstr1_v1_TKZ {
            label = "&MSTR1_V1_TKZ";
            compatible = "zmk,behavior-macro";
            #binding-cells = <0>;
            bindings = <&macro_press>
                , <&kp RALT>
                , <&macro_tap>
                , <&kp KP_N0>
                , <&kp KP_N1>
                , <&kp KP_N6>
                , <&kp KP_N1>
                , <&macro_release>
                , <&kp RALT>
                , <&macro_press>
                , <&kp LSHFT>
                , <&macro_tap>
                , <&kp H>
                , <&macro_release>
                , <&kp LSHFT>
                , <&macro_tap>
                , <&kp O>
                , <&kp L>
                , <&kp A>
                , <&kp LS(N1)>
                , <&kp SPACE>
                , <&kp RET>;
        };

        // macro string2 sample - Magic Layer F2 - Text output sample macro 2 "grammar check: <paste>" - TailorKey
        mstr2_v1_TKZ: mstr2_v1_TKZ {
            label = "&MSTR2_V1_TKZ";
            compatible = "zmk,behavior-macro";
            #binding-cells = <0>;
            bindings = <&macro_tap>
                , <&kp G>
                , <&kp R>
                , <&kp A>
                , <&kp M>
                , <&kp M>
                , <&kp A>
                , <&kp R>
                , <&kp SPACE>
                , <&kp C>
                , <&kp H>
                , <&kp E>
                , <&kp C>
                , <&kp K>
                , <&kp LS(SEMI)>
                , <&kp LC(V)>
                , <&kp RET>;
        };

        // Symbol layer dot dot
        symb_dotdot_v1_TKZ: symb_dotdot_v1_TKZ {
            label = "&SYMB_DOTDOT_V1_TKZ";
            compatible = "zmk,behavior-macro";
            #binding-cells = <0>;
            tap-ms = <0>;
            wait-ms = <0>;
            bindings = <&macro_tap>
                , <&kp DOT>
                , <&kp DOT>;
        };
    };
};

/* Automatically generated behavior definitions */
/ {
    behaviors {


        // AutoShift Helper - &AS main macro is chained to &AS_HT hold tap and &AS_Shifted macro. For faster typists, it is recommended to decrease the tapping-term-ms value. A suggested value is 135 ms.
        // More: https://github.com/nickcoutsos/keymap-editor/wiki/Autoshift-using-ZMK-behaviors
        AS_HT_v2_TKZ: AS_HT_v2_TKZ {
            compatible = "zmk,behavior-hold-tap";
            #binding-cells = <2>;
            tapping-term-ms = <190>;
            bindings = <&AS_Shifted_v1_TKZ>, <&kp>;
            flavor = "tap-preferred";
        };

        // Capsword helper - tap for caps_word - hold for key press
        CAPSWord_v1_TKZ: CAPSWord_v1_TKZ {
            compatible = "zmk,behavior-hold-tap";
            #binding-cells = <2>;
            tapping-term-ms = <200>;
            bindings = <&kp>, <&caps_word>;
        };

        // HRM_left_index_middy_bilateral -> &kp - &HRM_left_index_tap - TailorKey
        HRM_left_index_middy_v1B_TKZ: HRM_left_index_middy_v1B_TKZ {
            compatible = "zmk,behavior-hold-tap";
            #binding-cells = <2>;
            tapping-term-ms = <190>;
            bindings = <&kp>, <&HRM_left_index_tap_v1B_TKZ>;
            flavor = "tap-preferred";
            quick-tap-ms = <300>;
            require-prior-idle-ms = <100>;
            hold-trigger-key-positions = <57 56 55 72 73 74 5 6 7 8 16 17 18 19 20 28 29 30 31 32 40 41 42 43 44 58 59 60 61 62 75 76 77 78 9 21 33 45 63 79 52 53 54 70 71 69>;
            hold-trigger-on-release;
        };

        // HRM_left_index_pinky_bilateral -> &kp - &HRM_left_index_tap - TailorKey
        HRM_left_index_pinky_v1B_TKZ: HRM_left_index_pinky_v1B_TKZ {
            compatible = "zmk,behavior-hold-tap";
            #binding-cells = <2>;
            tapping-term-ms = <190>;
            bindings = <&kp>, <&HRM_left_index_tap_v1B_TKZ>;
            flavor = "tap-preferred";
            quick-tap-ms = <300>;
            require-prior-idle-ms = <100>;
            hold-trigger-key-positions = <57 56 55 72 73 74 5 6 7 8 16 17 18 19 20 28 29 30 31 32 40 41 42 43 44 58 59 60 61 62 75 76 77 78 9 21 33 45 63 79 52 53 54 70 71 69>;
            hold-trigger-on-release;
        };

        // HRM_left_index_ring_bilateral -> &kp - &HRM_left_index_tap - TailorKey
        HRM_left_index_ringv1_TKZ: HRM_left_index_ringv1_TKZ {
            compatible = "zmk,behavior-hold-tap";
            #binding-cells = <2>;
            tapping-term-ms = <190>;
            bindings = <&kp>, <&HRM_left_index_tap_v1B_TKZ>;
            flavor = "tap-preferred";
            quick-tap-ms = <300>;
            require-prior-idle-ms = <100>;
            hold-trigger-key-positions = <57 56 55 72 73 74 5 6 7 8 16 17 18 19 20 28 29 30 31 32 40 41 42 43 44 58 59 60 61 62 75 76 77 78 9 21 33 45 63 79 52 53 54 70 71 69>;
            hold-trigger-on-release;
        };

        // HRM_left_index_bilateral -> &HRM_left_index_hold -> &kp - TailorKey
        HRM_left_index_v1B_TKZ: HRM_left_index_v1B_TKZ {
            compatible = "zmk,behavior-hold-tap";
            #binding-cells = <2>;
            tapping-term-ms = <190>;
            bindings = <&HRM_left_index_hold_v1B_TKZ>, <&kp>;
            flavor = "tap-preferred";
            quick-tap-ms = <300>;
            require-prior-idle-ms = <100>;
            hold-trigger-key-positions = <57 56 55 72 73 74 5 6 7 8 16 17 18 19 20 28 29 30 31 32 40 41 42 43 44 58 59 60 61 62 75 76 77 78 9 21 33 45 63 79 52 53 54 70 71 69>;
            hold-trigger-on-release;
        };

        // HRM_left_middy_index_bilateral  -> &kp ->&HRM_left_middy_tap - TailorKey
        HRM_left_middy_index_v1B_TKZ: HRM_left_middy_index_v1B_TKZ {
            compatible = "zmk,behavior-hold-tap";
            #binding-cells = <2>;
            tapping-term-ms = <210>;
            bindings = <&kp>, <&HRM_left_middy_tap_v1B_TKZ>;
            flavor = "tap-preferred";
            quick-tap-ms = <300>;
            require-prior-idle-ms = <150>;
            hold-trigger-key-positions = <57 56 55 72 73 74 5 6 7 8 16 17 18 19 20 28 29 30 31 32 40 41 42 43 44 58 59 60 61 62 75 76 77 78 9 21 33 45 63 79 52 53 54 70 71 69>;
            hold-trigger-on-release;
        };

        // HRM_left_middy_pinky_bilateral -> &kp - &HRM_left_pinky_tap - TailorKey
        HRM_left_middy_pinky_v1B_TKZ: HRM_left_middy_pinky_v1B_TKZ {
            compatible = "zmk,behavior-hold-tap";
            #binding-cells = <2>;
            tapping-term-ms = <210>;
            bindings = <&kp>, <&HRM_left_middy_tap_v1B_TKZ>;
            flavor = "tap-preferred";
            quick-tap-ms = <300>;
            require-prior-idle-ms = <150>;
            hold-trigger-key-positions = <57 56 55 72 73 74 5 6 7 8 16 17 18 19 20 28 29 30 31 32 40 41 42 43 44 58 59 60 61 62 75 76 77 78 9 21 33 45 63 79 52 53 54 70 71 69>;
            hold-trigger-on-release;
        };

        // HRM_left_middy_ring_bilateral -> &kp - &HRM_left_middy_tap - TailorKey
        HRM_left_middy_ring_v1B_TKZ: HRM_left_middy_ring_v1B_TKZ {
            compatible = "zmk,behavior-hold-tap";
            #binding-cells = <2>;
            tapping-term-ms = <210>;
            bindings = <&kp>, <&HRM_left_middy_tap_v1B_TKZ>;
            flavor = "tap-preferred";
            quick-tap-ms = <300>;
            require-prior-idle-ms = <150>;
            hold-trigger-key-positions = <57 56 55 72 73 74 5 6 7 8 16 17 18 19 20 28 29 30 31 32 40 41 42 43 44 58 59 60 61 62 75 76 77 78 9 21 33 45 63 79 52 53 54 70 71 69>;
            hold-trigger-on-release;
        };

        // HRM_left_middy_bilateral -> &HRM_left_index_hold -> &kp - TailorKey
        HRM_left_middy_v1B_TKZ: HRM_left_middy_v1B_TKZ {
            compatible = "zmk,behavior-hold-tap";
            #binding-cells = <2>;
            tapping-term-ms = <210>;
            bindings = <&HRM_left_middy_hold_v1B_TKZ>, <&kp>;
            flavor = "tap-preferred";
            quick-tap-ms = <300>;
            require-prior-idle-ms = <150>;
            hold-trigger-key-positions = <57 56 55 72 73 74 5 6 7 8 16 17 18 19 20 28 29 30 31 32 40 41 42 43 44 58 59 60 61 62 75 76 77 78 9 21 33 45 63 79 52 53 54 70 71 69>;
            hold-trigger-on-release;
        };

        // HRM_left_pinky_index_bilateral  -> &kp ->&HRM_left_pinky_tap - TailorKey
        HRM_left_pinky_index_v1B_TKZ: HRM_left_pinky_index_v1B_TKZ {
            compatible = "zmk,behavior-hold-tap";
            #binding-cells = <2>;
            tapping-term-ms = <280>;
            bindings = <&kp>, <&HRM_left_pinky_tap_v1B_TKZ>;
            flavor = "tap-preferred";
            quick-tap-ms = <300>;
            require-prior-idle-ms = <150>;
            hold-trigger-key-positions = <57 56 55 72 73 74 5 6 7 8 16 17 18 19 20 28 29 30 31 32 40 41 42 43 44 58 59 60 61 62 75 76 77 78 9 21 33 45 63 79 52 53 54 70 71 69>;
            hold-trigger-on-release;
        };

        // HRM_left_pinky_middy_bilateral -> &kp - &HRM_left_pinky_tap - TailorKey
        HRM_left_pinky_middy_v1B_TKZ: HRM_left_pinky_middy_v1B_TKZ {
            compatible = "zmk,behavior-hold-tap";
            #binding-cells = <2>;
            tapping-term-ms = <280>;
            bindings = <&kp>, <&HRM_left_pinky_tap_v1B_TKZ>;
            flavor = "tap-preferred";
            quick-tap-ms = <300>;
            require-prior-idle-ms = <150>;
            hold-trigger-key-positions = <57 56 55 72 73 74 5 6 7 8 16 17 18 19 20 28 29 30 31 32 40 41 42 43 44 58 59 60 61 62 75 76 77 78 9 21 33 45 63 79 52 53 54 70 71 69>;
            hold-trigger-on-release;
        };

        // HRM_left_pinky_ring_bilateral -> &kp - &HRM_left_pinky_tap - TailorKey
        HRM_left_pinky_ring_v1B_TKZ: HRM_left_pinky_ring_v1B_TKZ {
            compatible = "zmk,behavior-hold-tap";
            #binding-cells = <2>;
            tapping-term-ms = <280>;
            bindings = <&kp>, <&HRM_left_pinky_tap_v1B_TKZ>;
            flavor = "tap-preferred";
            quick-tap-ms = <300>;
            require-prior-idle-ms = <150>;
            hold-trigger-key-positions = <57 56 55 72 73 74 5 6 7 8 16 17 18 19 20 28 29 30 31 32 40 41 42 43 44 58 59 60 61 62 75 76 77 78 9 21 33 45 63 79 52 53 54 70 71 69>;
            hold-trigger-on-release;
        };

        // HRM_left_pinky_bilateral  - &HRM_left_pinky_hold -> &kp - TailorKey
        HRM_left_pinky_v1B_TKZ: HRM_left_pinky_v1B_TKZ {
            compatible = "zmk,behavior-hold-tap";
            #binding-cells = <2>;
            tapping-term-ms = <280>;
            bindings = <&HRM_left_pinky_hold_v1B_TKZ>, <&kp>;
            flavor = "tap-preferred";
            quick-tap-ms = <300>;
            require-prior-idle-ms = <150>;
            hold-trigger-key-positions = <57 56 55 72 73 74 5 6 7 8 16 17 18 19 20 28 29 30 31 32 40 41 42 43 44 58 59 60 61 62 75 76 77 78 9 21 33 45 63 79 52 53 54 70 71 69>;
            hold-trigger-on-release;
        };

        // HRM_left_ring_index_bilateral  -> &kp ->&HRM_left_ring_tap - TailorKey
        HRM_left_ring_index_v1B_TKZ: HRM_left_ring_index_v1B_TKZ {
            compatible = "zmk,behavior-hold-tap";
            #binding-cells = <2>;
            tapping-term-ms = <240>;
            bindings = <&kp>, <&HRM_left_ring_tap_v1B_TKZ>;
            flavor = "tap-preferred";
            quick-tap-ms = <300>;
            require-prior-idle-ms = <100>;
            hold-trigger-key-positions = <57 56 55 72 73 74 5 6 7 8 16 17 18 19 20 28 29 30 31 32 40 41 42 43 44 58 59 60 61 62 75 76 77 78 9 21 33 45 63 79 52 53 54 70 71 69>;
            hold-trigger-on-release;
        };

        // HRM_left_ring_middy_bilateral -> &kp - &HRM_left_ring_tap - TailorKey
        HRM_left_ring_middy_v1B_TKZ: HRM_left_ring_middy_v1B_TKZ {
            compatible = "zmk,behavior-hold-tap";
            #binding-cells = <2>;
            tapping-term-ms = <240>;
            bindings = <&kp>, <&HRM_left_ring_tap_v1B_TKZ>;
            flavor = "tap-preferred";
            quick-tap-ms = <300>;
            require-prior-idle-ms = <150>;
            hold-trigger-key-positions = <57 56 55 72 73 74 5 6 7 8 16 17 18 19 20 28 29 30 31 32 40 41 42 43 44 58 59 60 61 62 75 76 77 78 9 21 33 45 63 79 52 53 54 70 71 69>;
            hold-trigger-on-release;
        };

        // HRM_left_ring_pinky_bilateral -> &kp - &HRM_left_ring_tap - TailorKey
        HRM_left_ring_pinky_v1B_TKZ: HRM_left_ring_pinky_v1B_TKZ {
            compatible = "zmk,behavior-hold-tap";
            #binding-cells = <2>;
            tapping-term-ms = <240>;
            bindings = <&kp>, <&HRM_left_ring_tap_v1B_TKZ>;
            flavor = "tap-preferred";
            quick-tap-ms = <300>;
            require-prior-idle-ms = <150>;
            hold-trigger-key-positions = <57 56 55 72 73 74 5 6 7 8 16 17 18 19 20 28 29 30 31 32 40 41 42 43 44 58 59 60 61 62 75 76 77 78 9 21 33 45 63 79 52 53 54 70 71 69>;
            hold-trigger-on-release;
        };

        // HRM_left_ring_bilateral  - &HRM_left_ring_hold -> &kp - TailorKey
        HRM_left_ring_v1B_TKZ: HRM_left_ring_v1B_TKZ {
            compatible = "zmk,behavior-hold-tap";
            #binding-cells = <2>;
            tapping-term-ms = <240>;
            bindings = <&HRM_left_ring_hold_v1B_TKZ>, <&kp>;
            flavor = "tap-preferred";
            quick-tap-ms = <300>;
            require-prior-idle-ms = <150>;
            hold-trigger-key-positions = <57 56 55 72 73 74 5 6 7 8 16 17 18 19 20 28 29 30 31 32 40 41 42 43 44 58 59 60 61 62 75 76 77 78 9 21 33 45 63 79 52 53 54 70 71 69>;
            hold-trigger-on-release;
        };

        // HRM_right_index_middy_bilateral -> &kp - &HRM_right_index_tap - TailorKey
        HRM_right_index_middy_v1B_TKZ: HRM_right_index_middy_v1B_TKZ {
            compatible = "zmk,behavior-hold-tap";
            #binding-cells = <2>;
            tapping-term-ms = <190>;
            bindings = <&kp>, <&HRM_right_index_tap_v1B_TKZ>;
            flavor = "tap-preferred";
            quick-tap-ms = <300>;
            require-prior-idle-ms = <100>;
            hold-trigger-key-positions = <0 10 22 34 46 64 65 47 35 23 1 2 12 11 24 36 48 66 67 49 37 25 13 3 4 14 15 27 26 38 39 51 50 68 52 53 54 71 70 69 55 56 57 74 73 72>;
            hold-trigger-on-release;
        };

        // HRM_right_index_pinky_bilateral -> &kp - &HRM_right_index_tap - TailorKey
        HRM_right_index_pinky_v1B_TKZ: HRM_right_index_pinky_v1B_TKZ {
            compatible = "zmk,behavior-hold-tap";
            #binding-cells = <2>;
            tapping-term-ms = <190>;
            bindings = <&kp>, <&HRM_right_index_tap_v1B_TKZ>;
            flavor = "tap-preferred";
            quick-tap-ms = <300>;
            require-prior-idle-ms = <100>;
            hold-trigger-key-positions = <0 10 22 34 46 64 65 47 35 23 1 2 12 11 24 36 48 66 67 49 37 25 13 3 4 14 15 27 26 38 39 51 50 68 52 53 54 71 70 69 55 56 57 74 73 72>;
            hold-trigger-on-release;
        };

        // HRM_right_index_ring_bilateral -> &kp - &HRM_right_index_tap - TailorKey
        HRM_right_index_ring_v1B_TKZ: HRM_right_index_ring_v1B_TKZ {
            compatible = "zmk,behavior-hold-tap";
            #binding-cells = <2>;
            tapping-term-ms = <190>;
            bindings = <&kp>, <&HRM_right_index_tap_v1B_TKZ>;
            flavor = "tap-preferred";
            quick-tap-ms = <300>;
            require-prior-idle-ms = <100>;
            hold-trigger-key-positions = <0 10 22 34 46 64 65 47 35 23 1 2 12 11 24 36 48 66 67 49 37 25 13 3 4 14 15 27 26 38 39 51 50 68 52 53 54 71 70 69 55 56 57 74 73 72>;
            hold-trigger-on-release;
        };

        // HRM_right_index_bilateral -> &HRM_right_index_hold -> &kp - TailorKey
        HRM_right_index_v1B_TKZ: HRM_right_index_v1B_TKZ {
            compatible = "zmk,behavior-hold-tap";
            #binding-cells = <2>;
            tapping-term-ms = <190>;
            bindings = <&HRM_right_index_hold_v1B_TKZ>, <&kp>;
            flavor = "tap-preferred";
            quick-tap-ms = <300>;
            require-prior-idle-ms = <100>;
            hold-trigger-key-positions = <0 10 22 34 46 64 65 47 35 23 1 2 12 11 24 36 48 66 67 49 37 25 13 3 4 14 15 27 26 38 39 51 50 68 52 53 54 71 70 69 55 56 57 74 73 72>;
            hold-trigger-on-release;
        };

        // HRM_right_middy_index_bilateral  -> &kp ->&HRM_right_middy_tap - TailorKey
        HRM_right_middy_index_v1B_TKZ: HRM_right_middy_index_v1B_TKZ {
            compatible = "zmk,behavior-hold-tap";
            #binding-cells = <2>;
            tapping-term-ms = <210>;
            bindings = <&kp>, <&HRM_right_middy_tap_v1B_TKZ>;
            flavor = "tap-preferred";
            quick-tap-ms = <300>;
            require-prior-idle-ms = <150>;
            hold-trigger-key-positions = <0 10 22 34 46 64 65 47 35 23 1 2 12 11 24 36 48 66 67 49 37 25 13 3 4 14 15 27 26 38 39 51 50 68 52 53 54 71 70 69 55 56 57 74 73 72>;
            hold-trigger-on-release;
        };

        // HRM_right_middy_pinky_bilateral -> &kp - &HRM_right_pinky_tap - TailorKey
        HRM_right_middy_pinky_v1B_TKZ: HRM_right_middy_pinky_v1B_TKZ {
            compatible = "zmk,behavior-hold-tap";
            #binding-cells = <2>;
            tapping-term-ms = <210>;
            bindings = <&kp>, <&HRM_right_middy_tap_v1B_TKZ>;
            flavor = "tap-preferred";
            quick-tap-ms = <300>;
            require-prior-idle-ms = <150>;
            hold-trigger-key-positions = <0 10 22 46 64 65 47 52 51 39 27 15 4 3 2 1 11 23 35 34 48 66 69 70 71 54 53 55 56 57 74 73 72 68 67 49 50 38 26 14 13 25 37 24 12 36>;
            hold-trigger-on-release;
        };

        // HRM_right_middy_ring_bilateral -> &kp - &HRM_right_middy_tap - TailorKey
        HRM_right_middy_ring_v1B_TKZ: HRM_right_middy_ring_v1B_TKZ {
            compatible = "zmk,behavior-hold-tap";
            #binding-cells = <2>;
            tapping-term-ms = <210>;
            bindings = <&kp>, <&HRM_right_middy_tap_v1B_TKZ>;
            flavor = "tap-preferred";
            quick-tap-ms = <300>;
            require-prior-idle-ms = <150>;
            hold-trigger-key-positions = <0 10 22 34 46 64 65 47 35 23 1 2 12 11 24 36 48 66 67 49 37 25 13 3 4 14 15 27 26 38 39 51 50 68 52 53 54 71 70 69 55 56 57 74 73 72>;
            hold-trigger-on-release;
        };

        // HRM_right_middy_bilateral -> &HRM_right_index_hold -> &kp - TailorKey
        HRM_right_middy_v1B_TKZ: HRM_right_middy_v1B_TKZ {
            compatible = "zmk,behavior-hold-tap";
            #binding-cells = <2>;
            tapping-term-ms = <210>;
            bindings = <&HRM_right_middy_hold_v1B_TKZ>, <&kp>;
            flavor = "tap-preferred";
            quick-tap-ms = <300>;
            require-prior-idle-ms = <150>;
            hold-trigger-key-positions = <0 10 22 34 46 64 65 47 35 23 1 2 12 11 24 36 48 66 67 49 37 25 13 3 4 14 15 27 26 38 39 51 50 68 52 53 54 71 70 69 55 56 57 74 73 72>;
            hold-trigger-on-release;
        };

        // HRM_right_pinky_index_bilateral  -> &kp ->&HRM_right_pinky_tap - TailorKey
        HRM_right_pinky_index_v1B_TKZ: HRM_right_pinky_index_v1B_TKZ {
            compatible = "zmk,behavior-hold-tap";
            #binding-cells = <2>;
            tapping-term-ms = <280>;
            bindings = <&kp>, <&HRM_right_pinky_tap_v1B_TKZ>;
            flavor = "tap-preferred";
            quick-tap-ms = <300>;
            require-prior-idle-ms = <150>;
            hold-trigger-key-positions = <0 10 22 34 46 64 65 47 35 23 1 2 12 11 24 36 48 66 67 49 37 25 13 3 4 14 15 27 26 38 39 51 50 68 52 53 54 71 70 69 55 56 57 74 73 72>;
            hold-trigger-on-release;
        };

        // HRM_right_pinky_middy_bilateral -> &kp - &HRM_right_pinky_tap - TailorKey
        HRM_right_pinky_middy_v1B_TKZ: HRM_right_pinky_middy_v1B_TKZ {
            compatible = "zmk,behavior-hold-tap";
            #binding-cells = <2>;
            tapping-term-ms = <280>;
            bindings = <&kp>, <&HRM_right_pinky_tap_v1B_TKZ>;
            flavor = "tap-preferred";
            quick-tap-ms = <300>;
            require-prior-idle-ms = <150>;
            hold-trigger-key-positions = <0 10 22 34 46 64 65 47 35 23 1 2 12 11 24 36 48 66 67 49 37 25 13 3 4 14 15 27 26 38 39 51 50 68 52 53 54 71 70 69 55 56 57 74 73 72>;
            hold-trigger-on-release;
        };

        // HRM_right_pinky_ring_bilateral -> &kp - &HRM_right_pinky_tap - TailorKey
        HRM_right_pinky_ring_v1B_TKZ: HRM_right_pinky_ring_v1B_TKZ {
            compatible = "zmk,behavior-hold-tap";
            #binding-cells = <2>;
            tapping-term-ms = <280>;
            bindings = <&kp>, <&HRM_right_pinky_tap_v1B_TKZ>;
            flavor = "tap-preferred";
            quick-tap-ms = <300>;
            require-prior-idle-ms = <150>;
            hold-trigger-key-positions = <0 10 22 34 46 64 65 47 35 23 1 2 12 11 24 36 48 66 67 49 37 25 13 3 4 14 15 27 26 38 39 51 50 68 52 53 54 71 70 69 55 56 57 74 73 72>;
            hold-trigger-on-release;
        };

        // HRM_right_pinky_bilateral  - &HRM_right_pinky_hold -> &kp - TailorKey
        HRM_right_pinky_v1B_TKZ: HRM_right_pinky_v1B_TKZ {
            compatible = "zmk,behavior-hold-tap";
            #binding-cells = <2>;
            tapping-term-ms = <280>;
            bindings = <&HRM_right_pinky_hold_v1B_TKZ>, <&kp>;
            flavor = "tap-preferred";
            quick-tap-ms = <300>;
            require-prior-idle-ms = <150>;
            hold-trigger-key-positions = <0 10 22 34 46 64 65 47 35 23 1 2 12 11 24 36 48 66 67 49 37 25 13 3 4 14 15 27 26 38 39 51 50 68 52 53 54 71 70 69 55 56 57 74 73 72>;
            hold-trigger-on-release;
        };

        // HRM_right_ring_index_bilateral  -> &kp ->&HRM_right_ring_tap - TailorKey
        HRM_right_ring_index_v1B_TKZ: HRM_right_ring_index_v1B_TKZ {
            compatible = "zmk,behavior-hold-tap";
            #binding-cells = <2>;
            tapping-term-ms = <240>;
            bindings = <&kp>, <&HRM_right_ring_tap_v1B_TKZ>;
            flavor = "tap-preferred";
            quick-tap-ms = <300>;
            require-prior-idle-ms = <150>;
            hold-trigger-key-positions = <0 10 22 34 46 64 65 47 35 23 1 2 12 11 24 36 48 66 67 49 37 25 13 3 4 14 15 27 26 38 39 51 50 68 52 53 54 71 70 69 55 56 57 74 73 72>;
            hold-trigger-on-release;
        };

        // HRM_right_ring_middy_bilateral -> &kp - &HRM_right_ring_tap - TailorKey
        HRM_right_ring_middy_v1B_TKZ: HRM_right_ring_middy_v1B_TKZ {
            compatible = "zmk,behavior-hold-tap";
            #binding-cells = <2>;
            tapping-term-ms = <240>;
            bindings = <&kp>, <&HRM_right_ring_tap_v1B_TKZ>;
            flavor = "tap-preferred";
            quick-tap-ms = <300>;
            require-prior-idle-ms = <150>;
            hold-trigger-key-positions = <0 10 22 34 46 64 65 47 35 23 1 2 12 11 24 36 48 66 67 49 37 25 13 3 4 14 15 27 26 38 39 51 50 68 52 53 54 71 70 69 55 56 57 74 73 72>;
            hold-trigger-on-release;
        };

        // HRM_right_ring_pinky_bilateral -> &kp - &HRM_right_ring_tap - TailorKey
        HRM_right_ring_pinky_v1B_TKZ: HRM_right_ring_pinky_v1B_TKZ {
            compatible = "zmk,behavior-hold-tap";
            #binding-cells = <2>;
            tapping-term-ms = <240>;
            bindings = <&kp>, <&HRM_right_ring_tap_v1B_TKZ>;
            flavor = "tap-preferred";
            quick-tap-ms = <300>;
            require-prior-idle-ms = <150>;
            hold-trigger-key-positions = <0 10 22 34 46 64 65 47 35 23 1 2 12 11 24 36 48 66 67 49 37 25 13 3 4 14 15 27 26 38 39 51 50 68 52 53 54 71 70 69 55 56 57 74 73 72>;
            hold-trigger-on-release;
        };

        // HRM_right_ring_bilateral  - &HRM_right_ring_hold -> &kp - TailorKey
        HRM_right_ring_v1B_TKZ: HRM_right_ring_v1B_TKZ {
            compatible = "zmk,behavior-hold-tap";
            #binding-cells = <2>;
            tapping-term-ms = <240>;
            bindings = <&HRM_right_ring_hold_v1B_TKZ>, <&kp>;
            flavor = "tap-preferred";
            quick-tap-ms = <300>;
            require-prior-idle-ms = <150>;
            hold-trigger-key-positions = <0 10 22 34 46 64 65 47 35 23 1 2 12 11 24 36 48 66 67 49 37 25 13 3 4 14 15 27 26 38 39 51 50 68 52 53 54 71 70 69 55 56 57 74 73 72>;
            hold-trigger-on-release;
        };

        // space_layer_access - TailorKey
        space_v3_TKZ: space_v3_TKZ {
            compatible = "zmk,behavior-hold-tap";
            #binding-cells = <2>;
            tapping-term-ms = <200>;
            bindings = <&mo>, <&kp>;
            flavor = "balanced";
            quick-tap-ms = <150>;
        };

        // thumb_layer_access - TailorKey
        thumb_v2_TKZ: thumb_v2_TKZ {
            compatible = "zmk,behavior-hold-tap";
            #binding-cells = <2>;
            tapping-term-ms = <200>;
            bindings = <&mo>, <&kp>;
            flavor = "balanced";
            quick-tap-ms = <300>;
        };
    };
};

/* Automatically generated combos definitions */
/ {
      combos {
          compatible = "zmk,combos";
                  // capslock when pressing both T1's - TailorKey
        combo_capslock_v1_TKZ {
            timeout-ms = <50>;
            key-positions = <52 57>;
            bindings = <&kp CAPS>;
            layers = <0 2>;
        };

        // F11 on RH_C5 and RH_R1+R2 - TailorKey
        combo_F11_v1_TKZ {
            timeout-ms = <50>;
            key-positions = <8 20>;
            bindings = <&kp F11>;
            layers = <0 2>;
        };

        // F12 on RH_C6 and RH_R1+R2 - TailorKey
        combo_F12_v1_TKZ {
            timeout-ms = <50>;
            key-positions = <9 21>;
            bindings = <&kp F12>;
            layers = <0 2>;
        };

        // sticky "hyper" modifiers (Win + Alt + Ctrl + Shift) - TailorKey
        combo_sticky_hyp_rght_v1_TKZ {
            timeout-ms = <50>;
            key-positions = <74 57>;
            bindings = <&sk LG(LA(LC(LSHFT)))>;
            layers = <0 2>;
        };

        // sticky "meh" modifiers (Alt + Ctrl + Shift) - TailorKey
        combo_sticky_meh_rght_v1_TKZ {
            timeout-ms = <50>;
            key-positions = <73 74>;
            bindings = <&sk LA(LC(LSHFT))>;
            layers = <0 2>;
        };

        // toggle gaming layer - TailorKey
        combo_gaming_layer_v1_TKZ {
            timeout-ms = <50>;
            key-positions = <51 68>;
            bindings = <&tog 5>;
        };
      };
    };

/* Automatically generated keymap */
/ {
    keymap {
        compatible = "zmk,keymap";


        layer_HRM_WinLinx {
            bindings = <
               &kp F1                          &kp F2                         &kp F3                           &kp F4                           &kp F5                                                                                                                                                                                     &kp F6                            &kp F7                          &kp F8                              &kp F9    &kp F10
            &kp EQUAL                          &kp N1                         &kp N2                           &kp N3                           &kp N4  &kp N5                                                                                                                                           &kp N6                            &kp N7                            &kp N8                          &kp N9                              &kp N0  &kp MINUS
              &kp TAB                           &kp Q                          &kp W                            &kp E                            &kp R   &kp T                                                                                                                                            &kp Y                             &kp U                             &kp I                           &kp O                               &kp P   &kp BSLH
              &kp ESC  &HRM_left_pinky_v1B_TKZ LGUI A  &HRM_left_ring_v1B_TKZ LALT S  &HRM_left_middy_v1B_TKZ LCTRL D  &HRM_left_index_v1B_TKZ LSHFT F   &kp G                                                                                                                                            &kp H  &HRM_right_index_v1B_TKZ RSHFT J  &HRM_right_middy_v1B_TKZ RCTRL K  &HRM_right_ring_v1B_TKZ LALT L  &HRM_right_pinky_v1B_TKZ RGUI SEMI    &kp SQT
            &kp GRAVE                           &kp Z                          &kp X                            &kp C                            &kp V   &kp B  &CAPSWord_v1_TKZ LSHFT MACRO_PLACEHOLDER  &kp LCTRL    &lower  &kp LGUI             &kp RCTRL  &CAPSWord_v1_TKZ RSHFT MACRO_PLACEHOLDER   &kp N                             &kp M                         &kp COMMA                         &kp DOT                            &kp FSLH  &kp PG_UP
 &magic LAYER_Magic 0                        &kp HOME                        &kp END                         &kp LEFT                        &kp RIGHT                              &thumb_v2_TKZ 3 BSPC    &kp DEL  &kp LALT  &kp RALT  &thumb_v2_TKZ 15 RET                     &space_v3_TKZ 4 SPACE                                    &kp UP                          &kp DOWN                        &kp LBKT                            &kp RBKT  &kp PG_DN
            >;
        };

        layer_Typing {
            bindings = <
 &trans  &trans  &trans  &trans  &trans                                                                  &trans  &trans  &trans    &trans  &trans
 &trans  &trans  &trans  &trans  &trans  &trans                                                  &trans  &trans  &trans  &trans    &trans  &trans
 &trans  &trans  &trans  &trans  &trans  &trans                                                  &trans  &trans  &trans  &trans    &trans  &trans
 &trans   &kp A   &kp S   &kp D   &kp F  &trans                                                  &trans   &kp J   &kp K   &kp L  &kp SEMI  &trans
 &trans  &trans  &trans  &trans  &trans  &trans  &trans  &trans  &trans  &trans  &trans  &trans  &trans  &trans  &trans  &trans    &trans  &trans
 &trans  &trans  &trans  &trans  &trans          &trans  &trans  &trans  &trans  &trans  &trans          &trans  &trans  &trans    &trans  &trans
            >;
        };

        layer_Autoshift {
            bindings = <
               &trans         &trans         &trans         &trans         &trans                                                                                       &trans            &trans           &trans           &trans            &trans
     &AS_v1_TKZ EQUAL  &AS_v1_TKZ N1  &AS_v1_TKZ N2  &AS_v1_TKZ N3  &AS_v1_TKZ N4  &AS_v1_TKZ N5                                                  &AS_v1_TKZ N6  &AS_v1_TKZ N7     &AS_v1_TKZ N8    &AS_v1_TKZ N9    &AS_v1_TKZ N0  &AS_v1_TKZ MINUS
               &trans   &AS_v1_TKZ Q   &AS_v1_TKZ W   &AS_v1_TKZ E   &AS_v1_TKZ R   &AS_v1_TKZ T                                                   &AS_v1_TKZ Y   &AS_v1_TKZ U      &AS_v1_TKZ I     &AS_v1_TKZ O     &AS_v1_TKZ P   &AS_v1_TKZ BSLH
               &trans   &AS_v1_TKZ A   &AS_v1_TKZ S   &AS_v1_TKZ D   &AS_v1_TKZ F   &AS_v1_TKZ G                                                   &AS_v1_TKZ H   &AS_v1_TKZ J      &AS_v1_TKZ K     &AS_v1_TKZ L  &AS_v1_TKZ SEMI    &AS_v1_TKZ SQT
     &AS_v1_TKZ GRAVE   &AS_v1_TKZ Z   &AS_v1_TKZ X   &AS_v1_TKZ C   &AS_v1_TKZ V   &AS_v1_TKZ B  &trans  &trans  &trans  &trans  &trans  &trans   &AS_v1_TKZ N   &AS_v1_TKZ M  &AS_v1_TKZ COMMA   &AS_v1_TKZ DOT  &AS_v1_TKZ FSLH            &trans
 &magic LAYER_Magic 0         &trans         &trans         &trans         &trans                 &trans  &trans  &trans  &trans  &trans  &trans                        &trans            &trans  &AS_v1_TKZ LBKT  &AS_v1_TKZ RBKT            &trans
            >;
        };

        layer_Cursor {
            bindings = <
     &none      &none                    &none                    &none      &none                                                                                                                                                                 &none          &none      &none      &none      &none
     &none    &kp ESC                  &kp INS              &kp LS(TAB)    &kp DEL      &none                                                                                                                                         &none        &none          &none      &none      &none      &none
     &none    &kp RET                &kp SPACE                  &kp TAB   &kp BSPC  &kp LC(X)                                                                                                                                     &kp LC(X)  &kp LS(TAB)      &kp LC(Z)  &kp LC(Y)    &kp TAB      &none
 &sk LSHFT   &kp LGUI                 &kp LALT                &kp LCTRL  &kp LSHFT  &kp LC(C)                                                                                                                                     &kp LC(C)     &kp LEFT         &kp UP   &kp DOWN  &kp RIGHT  &sk RSHFT
 &kp LC(L)  &kp LC(A)  &cur_SELECT_LINE_v1_TKZ  &cur_SELECT_WORD_v1_TKZ  &kp LC(F)  &kp LC(V)  &mod_tab_v2_TKZ LALT   &mod_tab_v2_TKZ LGUI  &kp PSCRN  &cur_SELECT_NONE_v1_TKZ  &cur_EXTEND_LINE_v1_TKZ  &cur_EXTEND_WORD_v1_TKZ  &kp LC(V)     &kp HOME      &kp PG_UP  &kp PG_DN    &kp END  &kp LC(L)
 &kp LC(K)  &kp LC(Z)                &kp LC(Y)            &kp LC(LS(G))  &kp LC(G)                            &none  &mod_tab_v2_TKZ LCTRL  &kp LG(D)                &kp LC(A)  &cur_SELECT_LINE_v1_TKZ  &cur_SELECT_WORD_v1_TKZ               &kp LC(F)  &kp LC(LS(G))  &kp LC(G)  &kp LC(H)  &kp LC(K)
            >;
        };

        layer_Symbol {
            bindings = <
               &none          &none         &none                 &none          &none                                                                                                        &none        &none      &none     &none   &none
           &kp GRAVE      &kp COMMA    &kp LS(N9)            &kp LS(N0)       &kp SEMI       &kp DOT                                                                               &none      &none        &none      &none     &none   &none
          &kp LS(N1)       &kp LBKT  &kp LS(LBKT)          &kp LS(RBKT)       &kp RBKT  &kp LS(FSLH)                                                                           &kp GRAVE    &kp DEL  &kp LS(TAB)    &kp INS   &kp ESC   &none
          &kp LS(N3)     &kp LS(N6)     &kp EQUAL         &kp LS(MINUS)     &kp LS(N4)    &kp LS(N8)                                                                &kp LS(SINGLE_QUOTE)   &kp BSPC      &kp TAB  &kp SPACE   &kp RET   &none
       &kp LS(GRAVE)  &kp LS(COMMA)  &kp LS(BSLH)             &kp MINUS    &kp LS(DOT)      &kp FSLH    &kp BSLH       &kp DOT  &kp LS(N8)   &none   &none   &none               &kp SQT  &sk RSHFT    &sk RCTRL   &sk RALT  &sk RGUI   &none
 &symb_dotdot_v1_TKZ     &kp LS(N7)       &kp SQT  &kp LS(SINGLE_QUOTE)  &kp LS(EQUAL)                &kp LS(N5)  &kp LS(SEMI)  &kp LS(N2)   &none   &none   &none                            &none        &none      &none     &none   &none
            >;
        };

        layer_Gaming {
            bindings = <
 &kp ESC      &kp P   &kp O   &kp N  &kp BSPC                                                                                   &kp F1     &kp F2    &kp F3     &kp F4     &kp F5
   &kp M     &kp N6  &kp N7  &kp N8    &kp N9  &kp N0                                                                &kp F6     &kp F7     &kp F8    &kp F9    &kp F10    &kp F11
   &kp I     &kp N1  &kp N2  &kp N3    &kp N4  &kp N5                                                                 &kp Y      &kp U      &kp I     &kp O      &kp P    &kp F12
   &kp T    &kp TAB   &kp Q   &kp W     &kp E   &kp R                                                                 &kp H      &kp J      &kp K     &kp L   &kp SEMI    &kp SQT
   &kp G  &kp LSHFT   &kp A   &kp S     &kp D   &kp F  &kp LSHFT   &kp LALT    &kp V   &kp ESC    &kp UP    &kp RET   &kp N      &kp M  &kp COMMA   &kp DOT   &kp FSLH   &kp BSLH
   &kp B  &kp LCTRL   &kp Z   &kp X     &kp C          &kp SPACE  &kp LCTRL  &kp RET  &kp LEFT  &kp DOWN  &kp RIGHT          &kp MINUS   &kp LBKT  &kp RBKT  &kp EQUAL  &kp GRAVE
            >;
        };

        layer_Lower {
            bindings = <
         &kp C_BRI_DN  &kp C_BRI_UP      &kp C_PREV      &kp C_NEXT         &kp C_PP                                                                         &kp C_MUTE  &kp C_VOL_DN  &kp C_VOL_UP            &none  &kp PAUSE_BREAK
               &trans         &none           &none           &none            &none   &kp HOME                                                  &kp LS(N9)  &kp KP_NUM     &kp EQUAL  &kp KP_SLASH  &kp KP_MULTIPLY  &kp PRINTSCREEN
               &trans         &none           &none    &kp UP_ARROW            &none    &kp END                                                  &kp LS(N0)   &kp KP_N7     &kp KP_N8     &kp KP_N9     &kp KP_MINUS   &kp SCROLLLOCK
               &trans         &none  &kp LEFT_ARROW  &kp DOWN_ARROW  &kp RIGHT_ARROW  &kp PG_UP                                                  &kp LS(N5)   &kp KP_N4     &kp KP_N5     &kp KP_N6      &kp KP_PLUS            &none
               &trans     &kp K_APP           &none         &kp F11          &kp F12  &kp PG_DN  &trans  &trans   &to 0  &trans  &trans  &trans   &kp COMMA   &kp KP_N1     &kp KP_N2     &kp KP_N3     &kp KP_ENTER           &trans
 &magic LAYER_Magic 0      &kp CAPS         &kp INS         &kp F11          &kp F12             &trans  &trans  &trans  &trans  &trans  &trans               &kp KP_N0     &kp KP_N0    &kp KP_DOT     &kp KP_ENTER           &trans
            >;
        };

        layer_LeftIndex {
            bindings = <
    &HRM_left_index_tap_v1B_TKZ F1        &HRM_left_index_tap_v1B_TKZ F2     &HRM_left_index_tap_v1B_TKZ F3         &HRM_left_index_tap_v1B_TKZ F4  &HRM_left_index_tap_v1B_TKZ F5                                                                                          &trans  &trans  &trans    &trans  &trans
 &HRM_left_index_tap_v1B_TKZ EQUAL        &HRM_left_index_tap_v1B_TKZ N1     &HRM_left_index_tap_v1B_TKZ N2         &HRM_left_index_tap_v1B_TKZ N3  &HRM_left_index_tap_v1B_TKZ N4  &HRM_left_index_tap_v1B_TKZ N5                                                  &trans  &trans  &trans  &trans    &trans  &trans
                            &trans         &HRM_left_index_tap_v1B_TKZ Q      &HRM_left_index_tap_v1B_TKZ W          &HRM_left_index_tap_v1B_TKZ E   &HRM_left_index_tap_v1B_TKZ R   &HRM_left_index_tap_v1B_TKZ T                                                  &trans  &trans  &trans  &trans    &trans  &trans
                            &trans  &HRM_left_index_pinky_v1B_TKZ LGUI A  &HRM_left_index_ringv1_TKZ LALT S  &HRM_left_index_middy_v1B_TKZ LCTRL D                           &none   &HRM_left_index_tap_v1B_TKZ G                                                  &trans   &kp J   &kp K   &kp L  &kp SEMI  &trans
                            &trans         &HRM_left_index_tap_v1B_TKZ Z      &HRM_left_index_tap_v1B_TKZ X          &HRM_left_index_tap_v1B_TKZ C   &HRM_left_index_tap_v1B_TKZ V   &HRM_left_index_tap_v1B_TKZ B  &trans  &trans  &trans  &trans  &trans  &trans  &trans  &trans  &trans  &trans    &trans  &trans
                            &trans                                &trans                             &trans                                 &trans                          &trans                                  &trans  &trans  &trans  &trans  &trans  &trans          &trans  &trans  &trans    &trans  &trans
            >;
        };

        layer_LeftMiddy {
            bindings = <
    &HRM_left_middy_tap_v1B_TKZ F1        &HRM_left_middy_tap_v1B_TKZ F2       &HRM_left_middy_tap_v1B_TKZ F3  &HRM_left_middy_tap_v1B_TKZ F4         &HRM_left_middy_tap_v1B_TKZ F5                                                                                          &trans  &trans  &trans    &trans  &trans
 &HRM_left_middy_tap_v1B_TKZ EQUAL        &HRM_left_middy_tap_v1B_TKZ N1       &HRM_left_middy_tap_v1B_TKZ N2  &HRM_left_middy_tap_v1B_TKZ N3         &HRM_left_middy_tap_v1B_TKZ N4  &HRM_left_middy_tap_v1B_TKZ N5                                                  &trans  &trans  &trans  &trans    &trans  &trans
                            &trans         &HRM_left_middy_tap_v1B_TKZ Q        &HRM_left_middy_tap_v1B_TKZ W   &HRM_left_middy_tap_v1B_TKZ E          &HRM_left_middy_tap_v1B_TKZ R   &HRM_left_middy_tap_v1B_TKZ T                                                  &trans  &trans  &trans  &trans    &trans  &trans
                            &trans  &HRM_left_middy_pinky_v1B_TKZ LGUI A  &HRM_left_middy_ring_v1B_TKZ LALT S                           &none  &HRM_left_middy_index_v1B_TKZ LSHFT F   &HRM_left_middy_tap_v1B_TKZ G                                                  &trans   &kp J   &kp K   &kp L  &kp SEMI  &trans
                            &trans         &HRM_left_middy_tap_v1B_TKZ Z        &HRM_left_middy_tap_v1B_TKZ X   &HRM_left_middy_tap_v1B_TKZ C          &HRM_left_middy_tap_v1B_TKZ V   &HRM_left_middy_tap_v1B_TKZ B  &trans  &trans  &trans  &trans  &trans  &trans  &trans  &trans  &trans  &trans    &trans  &trans
                            &trans                                &trans                               &trans                          &trans                                 &trans                                  &trans  &trans  &trans  &trans  &trans  &trans          &trans  &trans  &trans    &trans  &trans
            >;
        };

        layer_LeftRingy {
            bindings = <
    &HRM_left_ring_tap_v1B_TKZ F1        &HRM_left_ring_tap_v1B_TKZ F2  &HRM_left_ring_tap_v1B_TKZ F3         &HRM_left_ring_tap_v1B_TKZ F4         &HRM_left_ring_tap_v1B_TKZ F5                                                                                         &trans  &trans  &trans    &trans  &trans
 &HRM_left_ring_tap_v1B_TKZ EQUAL        &HRM_left_ring_tap_v1B_TKZ N1  &HRM_left_ring_tap_v1B_TKZ N2         &HRM_left_ring_tap_v1B_TKZ N3         &HRM_left_ring_tap_v1B_TKZ N4  &HRM_left_ring_tap_v1B_TKZ N5                                                  &trans  &trans  &trans  &trans    &trans  &trans
                           &trans         &HRM_left_ring_tap_v1B_TKZ Q   &HRM_left_ring_tap_v1B_TKZ W          &HRM_left_ring_tap_v1B_TKZ E          &HRM_left_ring_tap_v1B_TKZ R   &HRM_left_ring_tap_v1B_TKZ T                                                  &trans  &trans  &trans  &trans    &trans  &trans
                           &trans  &HRM_left_ring_pinky_v1B_TKZ LGUI A                          &none  &HRM_left_ring_middy_v1B_TKZ LCTRL D  &HRM_left_ring_index_v1B_TKZ LSHFT F   &HRM_left_ring_tap_v1B_TKZ G                                                  &trans   &kp J   &kp K   &kp L  &kp SEMI  &trans
                           &trans         &HRM_left_ring_tap_v1B_TKZ Z   &HRM_left_ring_tap_v1B_TKZ X          &HRM_left_ring_tap_v1B_TKZ C          &HRM_left_ring_tap_v1B_TKZ V   &HRM_left_ring_tap_v1B_TKZ B  &trans  &trans  &trans  &trans  &trans  &trans  &trans  &trans  &trans  &trans    &trans  &trans
                           &trans                               &trans                         &trans                                &trans                                &trans                                 &trans  &trans  &trans  &trans  &trans  &trans          &trans  &trans  &trans    &trans  &trans
            >;
        };

        layer_LeftPinky {
            bindings = <
    &HRM_left_pinky_tap_v1B_TKZ F1  &HRM_left_pinky_tap_v1B_TKZ F2       &HRM_left_pinky_tap_v1B_TKZ F3         &HRM_left_pinky_tap_v1B_TKZ F4         &HRM_left_pinky_tap_v1B_TKZ F5                                                                                          &trans  &trans  &trans    &trans  &trans
 &HRM_left_pinky_tap_v1B_TKZ EQUAL  &HRM_left_pinky_tap_v1B_TKZ N1       &HRM_left_pinky_tap_v1B_TKZ N2         &HRM_left_pinky_tap_v1B_TKZ N3         &HRM_left_pinky_tap_v1B_TKZ N4  &HRM_left_pinky_tap_v1B_TKZ N5                                                  &trans  &trans  &trans  &trans    &trans  &trans
                            &trans   &HRM_left_pinky_tap_v1B_TKZ Q        &HRM_left_pinky_tap_v1B_TKZ W          &HRM_left_pinky_tap_v1B_TKZ E          &HRM_left_pinky_tap_v1B_TKZ R   &HRM_left_pinky_tap_v1B_TKZ T                                                  &trans  &trans  &trans  &trans    &trans  &trans
                            &trans                           &none  &HRM_left_pinky_ring_v1B_TKZ LALT S  &HRM_left_pinky_middy_v1B_TKZ LCTRL D  &HRM_left_pinky_index_v1B_TKZ LSHFT F   &HRM_left_pinky_tap_v1B_TKZ G                                                  &trans   &kp J   &kp K   &kp L  &kp SEMI  &trans
                            &trans   &HRM_left_pinky_tap_v1B_TKZ Z        &HRM_left_pinky_tap_v1B_TKZ X          &HRM_left_pinky_tap_v1B_TKZ C          &HRM_left_pinky_tap_v1B_TKZ V   &HRM_left_pinky_tap_v1B_TKZ B  &trans  &trans  &trans  &trans  &trans  &trans  &trans  &trans  &trans  &trans    &trans  &trans
                            &trans                          &trans                               &trans                                 &trans                                 &trans                                  &trans  &trans  &trans  &trans  &trans  &trans          &trans  &trans  &trans    &trans  &trans
            >;
        };

        layer_RightIndex {
            bindings = <
 &trans  &trans  &trans  &trans  &trans                                                                                           &HRM_right_index_tap_v1B_TKZ F6         &HRM_right_index_tap_v1B_TKZ F7       &HRM_right_index_tap_v1B_TKZ F8           &HRM_right_index_tap_v1B_TKZ F9    &HRM_right_index_tap_v1B_TKZ F10
 &trans  &trans  &trans  &trans  &trans  &trans                                                  &HRM_right_index_tap_v1B_TKZ N6  &HRM_right_index_tap_v1B_TKZ N7         &HRM_right_index_tap_v1B_TKZ N8       &HRM_right_index_tap_v1B_TKZ N9           &HRM_right_index_tap_v1B_TKZ N0  &HRM_right_index_tap_v1B_TKZ MINUS
 &trans  &trans  &trans  &trans  &trans  &trans                                                   &HRM_right_index_tap_v1B_TKZ Y   &HRM_right_index_tap_v1B_TKZ U          &HRM_right_index_tap_v1B_TKZ I        &HRM_right_index_tap_v1B_TKZ O            &HRM_right_index_tap_v1B_TKZ P   &HRM_right_index_tap_v1B_TKZ BSLH
 &trans   &kp A   &kp S   &kp D   &kp F  &trans                                                   &HRM_right_index_tap_v1B_TKZ H                            &none  &HRM_right_index_middy_v1B_TKZ RCTRL K  &HRM_right_index_ring_v1B_TKZ LALT L  &HRM_right_index_pinky_v1B_TKZ RGUI SEMI    &HRM_right_index_tap_v1B_TKZ SQT
 &trans  &trans  &trans  &trans  &trans  &trans  &trans  &trans  &trans  &trans  &trans  &trans   &HRM_right_index_tap_v1B_TKZ N   &HRM_right_index_tap_v1B_TKZ M      &HRM_right_index_tap_v1B_TKZ COMMA      &HRM_right_index_tap_v1B_TKZ DOT                                    &trans                              &trans
 &trans  &trans  &trans  &trans  &trans          &trans  &trans  &trans  &trans  &trans  &trans                                                            &trans                                  &trans                                &trans                                    &trans                              &trans
            >;
        };

        layer_RightMiddy {
            bindings = <
 &trans  &trans  &trans  &trans  &trans                                                                                                  &HRM_right_middy_tap_v1B_TKZ F6     &HRM_right_middy_tap_v1B_TKZ F7       &HRM_right_middy_tap_v1B_TKZ F8           &HRM_right_middy_tap_v1B_TKZ F9    &HRM_right_middy_tap_v1B_TKZ F10
 &trans  &trans  &trans  &trans  &trans  &trans                                                  &HRM_right_middy_tap_v1B_TKZ N6         &HRM_right_middy_tap_v1B_TKZ N7     &HRM_right_middy_tap_v1B_TKZ N8       &HRM_right_middy_tap_v1B_TKZ N9           &HRM_right_middy_tap_v1B_TKZ N0  &HRM_right_middy_tap_v1B_TKZ MINUS
 &trans  &trans  &trans  &trans  &trans  &trans                                                   &HRM_right_middy_tap_v1B_TKZ Y          &HRM_right_middy_tap_v1B_TKZ U      &HRM_right_middy_tap_v1B_TKZ I        &HRM_right_middy_tap_v1B_TKZ O            &HRM_right_middy_tap_v1B_TKZ P   &HRM_right_middy_tap_v1B_TKZ BSLH
 &trans   &kp A   &kp S   &kp D   &kp F  &trans                                                   &HRM_right_middy_tap_v1B_TKZ H  &HRM_right_middy_index_v1B_TKZ RSHFT J                               &none  &HRM_right_middy_ring_v1B_TKZ LALT L  &HRM_right_middy_pinky_v1B_TKZ RGUI SEMI    &HRM_right_middy_tap_v1B_TKZ SQT
 &trans  &trans  &trans  &trans  &trans  &trans  &trans  &trans  &trans  &trans  &trans  &trans   &HRM_right_middy_tap_v1B_TKZ N          &HRM_right_middy_tap_v1B_TKZ M  &HRM_right_middy_tap_v1B_TKZ COMMA      &HRM_right_middy_tap_v1B_TKZ DOT                                    &trans                              &trans
 &trans  &trans  &trans  &trans  &trans          &trans  &trans  &trans  &trans  &trans  &trans                                                                   &trans                              &trans                                &trans                                    &trans                              &trans
            >;
        };

        layer_RightRingy {
            bindings = <
 &trans  &trans  &trans  &trans  &trans                                                                                                 &HRM_right_ring_tap_v1B_TKZ F6         &HRM_right_ring_tap_v1B_TKZ F7   &HRM_right_ring_tap_v1B_TKZ F8           &HRM_right_ring_tap_v1B_TKZ F9    &HRM_right_ring_tap_v1B_TKZ F10
 &trans  &trans  &trans  &trans  &trans  &trans                                                  &HRM_right_ring_tap_v1B_TKZ N6         &HRM_right_ring_tap_v1B_TKZ N7         &HRM_right_ring_tap_v1B_TKZ N8   &HRM_right_ring_tap_v1B_TKZ N9           &HRM_right_ring_tap_v1B_TKZ N0  &HRM_right_ring_tap_v1B_TKZ MINUS
 &trans  &trans  &trans  &trans  &trans  &trans                                                   &HRM_right_ring_tap_v1B_TKZ Y          &HRM_right_ring_tap_v1B_TKZ U          &HRM_right_ring_tap_v1B_TKZ I    &HRM_right_ring_tap_v1B_TKZ O            &HRM_right_ring_tap_v1B_TKZ P   &HRM_right_ring_tap_v1B_TKZ BSLH
 &trans   &kp A   &kp S   &kp D   &kp F  &trans                                                   &HRM_right_ring_tap_v1B_TKZ H  &HRM_right_ring_index_v1B_TKZ RSHFT J  &HRM_right_ring_middy_v1B_TKZ RCTRL K                            &none  &HRM_right_ring_pinky_v1B_TKZ RGUI SEMI    &HRM_right_ring_tap_v1B_TKZ SQT
 &trans  &trans  &trans  &trans  &trans  &trans  &trans  &trans  &trans  &trans  &trans  &trans   &HRM_right_ring_tap_v1B_TKZ N          &HRM_right_ring_tap_v1B_TKZ M      &HRM_right_ring_tap_v1B_TKZ COMMA  &HRM_right_ring_tap_v1B_TKZ DOT                                   &trans                             &trans
 &trans  &trans  &trans  &trans  &trans          &trans  &trans  &trans  &trans  &trans  &trans                                                                 &trans                                 &trans                           &trans                                   &trans                             &trans
            >;
        };

        layer_RightPinky {
            bindings = <
 &trans  &trans  &trans  &trans  &trans                                                                                                  &HRM_right_pinky_tap_v1B_TKZ F6         &HRM_right_pinky_tap_v1B_TKZ F7       &HRM_right_pinky_tap_v1B_TKZ F8  &HRM_right_pinky_tap_v1B_TKZ F9    &HRM_right_pinky_tap_v1B_TKZ F10
 &trans  &trans  &trans  &trans  &trans  &trans                                                  &HRM_right_pinky_tap_v1B_TKZ N6         &HRM_right_pinky_tap_v1B_TKZ N7         &HRM_right_pinky_tap_v1B_TKZ N8       &HRM_right_pinky_tap_v1B_TKZ N9  &HRM_right_pinky_tap_v1B_TKZ N0  &HRM_right_pinky_tap_v1B_TKZ MINUS
 &trans  &trans  &trans  &trans  &trans  &trans                                                   &HRM_right_pinky_tap_v1B_TKZ Y          &HRM_right_pinky_tap_v1B_TKZ U          &HRM_right_pinky_tap_v1B_TKZ I        &HRM_right_pinky_tap_v1B_TKZ O   &HRM_right_pinky_tap_v1B_TKZ P   &HRM_right_pinky_tap_v1B_TKZ BSLH
 &trans   &kp A   &kp S   &kp D   &kp F  &trans                                                   &HRM_right_pinky_tap_v1B_TKZ H  &HRM_right_pinky_index_v1B_TKZ RSHFT J  &HRM_right_pinky_middy_v1B_TKZ RCTRL K  &HRM_right_pinky_ring_v1B_TKZ LALT L                            &none    &HRM_right_pinky_tap_v1B_TKZ SQT
 &trans  &trans  &trans  &trans  &trans  &trans  &trans  &trans  &trans  &trans  &trans  &trans   &HRM_right_pinky_tap_v1B_TKZ N          &HRM_right_pinky_tap_v1B_TKZ M      &HRM_right_pinky_tap_v1B_TKZ COMMA      &HRM_right_pinky_tap_v1B_TKZ DOT                           &trans                              &trans
 &trans  &trans  &trans  &trans  &trans          &trans  &trans  &trans  &trans  &trans  &trans                                                                   &trans                                  &trans                                &trans                           &trans                              &trans
            >;
        };

        layer_Mouse {
            bindings = <
  &none           &none           &none           &none            &none                                                                                                                &none           &none            &none      &none      &none
  &none           &none           &none           &none            &none           &none                                                                                &none           &none           &none            &none      &none      &none
  &none           &none  &msc SCRL_LEFT    &mmv MOVE_UP  &msc SCRL_RIGHT           &none                                                                                &none       &sk RSHFT       &sk RCTRL         &sk RALT   &sk RGUI      &none
  &none    &msc SCRL_UP  &mmv MOVE_LEFT  &mmv MOVE_DOWN  &mmv MOVE_RIGHT    &msc SCRL_UP                                                                         &msc SCRL_UP          &mo 17          &mo 18           &mo 16  &mkp LCLK   &mkp MB4
  &none  &msc SCRL_DOWN          &mo 16          &mo 18           &mo 17  &msc SCRL_DOWN  &mkp MCLK  &kp K_APP  &mkp MB5  &kp LC(X)  &kp LC(C)  &kp LC(LC(V))  &msc SCRL_DOWN  &msc SCRL_LEFT    &mmv MOVE_UP  &msc SCRL_RIGHT  &mkp RCLK   &mkp MB5
  &none           &none           &none           &none            &none                  &mkp LCLK  &mkp RCLK  &mkp MB4      &none      &none          &none                  &mmv MOVE_LEFT  &mmv MOVE_DOWN  &mmv MOVE_RIGHT  &mkp MCLK  &kp K_APP
            >;
        };

        layer_MouseSlow {
            bindings = <
 &trans  &trans  &trans  &trans  &trans                                                                  &trans  &trans  &trans  &trans  &trans
 &trans  &trans  &trans  &trans  &trans  &trans                                                  &trans  &trans  &trans  &trans  &trans  &trans
 &trans  &trans  &trans  &trans  &trans  &trans                                                  &trans  &trans  &trans  &trans  &trans  &trans
 &trans  &trans  &trans  &trans  &trans  &trans                                                  &trans  &trans  &trans  &trans  &trans  &trans
 &trans  &trans  &trans  &trans  &trans  &trans  &trans  &trans  &trans  &trans  &trans  &trans  &trans  &trans  &trans  &trans  &trans  &trans
 &trans  &trans  &trans  &trans  &trans          &trans  &trans  &trans  &trans  &trans  &trans          &trans  &trans  &trans  &trans  &trans
            >;
        };

        layer_MouseFast {
            bindings = <
 &trans  &trans  &trans  &trans  &trans                                                                  &trans  &trans  &trans  &trans  &trans
 &trans  &trans  &trans  &trans  &trans  &trans                                                  &trans  &trans  &trans  &trans  &trans  &trans
 &trans  &trans  &trans  &trans  &trans  &trans                                                  &trans  &trans  &trans  &trans  &trans  &trans
 &trans  &trans  &trans  &trans  &trans  &trans                                                  &trans  &trans  &trans  &trans  &trans  &trans
 &trans  &trans  &trans  &trans  &trans  &trans  &trans  &trans  &trans  &trans  &trans  &trans  &trans  &trans  &trans  &trans  &trans  &trans
 &trans  &trans  &trans  &trans  &trans          &trans  &trans  &trans  &trans  &trans  &trans          &trans  &trans  &trans  &trans  &trans
            >;
        };

        layer_MouseWarp {
            bindings = <
 &trans  &trans  &trans  &trans  &trans                                                                  &trans  &trans  &trans  &trans  &trans
 &trans  &trans  &trans  &trans  &trans  &trans                                                  &trans  &trans  &trans  &trans  &trans  &trans
 &trans  &trans  &trans  &trans  &trans  &trans                                                  &trans  &trans  &trans  &trans  &trans  &trans
 &trans  &trans  &trans  &trans  &trans  &trans                                                  &trans  &trans  &trans  &trans  &trans  &trans
 &trans  &trans  &trans  &trans  &trans  &trans  &trans  &trans  &trans  &trans  &trans  &trans  &trans  &trans  &trans  &trans  &trans  &trans
 &trans  &trans  &trans  &trans  &trans          &trans  &trans  &trans  &trans  &trans  &trans          &trans  &trans  &trans  &trans  &trans
            >;
        };

        layer_Magic {
            bindings = <
 &mstr1_v1_TKZ    &mstr2_v1_TKZ            &none            &none            &none                                                                                  &none   &none   &none  &bt BT_CLR  &bt BT_CLR_ALL
         &to 0            &none            &to 1            &none            &none            &to 2                                                         &none   &none   &none   &none       &none           &none
         &none  &rgb_ug RGB_SPI  &rgb_ug RGB_SAI  &rgb_ug RGB_HUI  &rgb_ug RGB_BRI  &rgb_ug RGB_TOG                                                         &none   &none   &none   &none       &none           &none
   &bootloader  &rgb_ug RGB_SPD  &rgb_ug RGB_SAD  &rgb_ug RGB_HUD  &rgb_ug RGB_BRD  &rgb_ug RGB_EFF                                                         &none   &none   &none   &none       &none     &bootloader
    &sys_reset            &none            &none            &none            &none            &none   &bt_2   &bt_3         &none   &none   &none   &none   &none   &none   &none   &none       &none      &sys_reset
         &none            &none            &none            &none            &none                    &bt_0   &bt_1  &out OUT_USB   &none   &none   &none           &none   &none   &none       &none           &none
            >;
        };

    };
};
